/* source keypos definitions */
#include "../zmk-nodefree-config/keypos_def/keypos_42keys.h"

/* map Zen's extra keys */
#define X_RH  SMART_NUM    // thumb row, right

#define X_LT  &kp TAB
#define X_LM  &kp LSHIFT
#define X_LB  &kp LCTRL
#define X_LH  &kp K_COPY

#define X_RT  &kp EQUAL
#define X_RM  &kp SQT
#define X_RB  &key_repeat


/* activate bluetooth */
#define CONFIG_WIRELESS 1

/* source the main keymap */
#include "base.keymap"
